AUTOSAR XML (schema 4.0)
package /CentralSecurityGateway_Topology
  system Central_Gateway_E_E_Architecture: category=AUTOMOTIVE_SECURITY_GATEWAY
  firewall filter table Gateway_Packet_Filtering_Policy: rule{source-interface=DoIP_Diagnostics_Port, target-interface=CANFD_Powertrain_Subnet, protocol=SOME/IP, criteria=VehicleSpeed > 0 km/h}
  security event collector Distributed_IDS_Sensor_Manager: logging-protocol=AUTOSAR_SECMON_SOMEIP
    trust-boundaries:
      source=Diagnostics OBD-II Physical Port, target=Central Security Gateway Kernel, interface=DoIP ISO 13400-2 Port 13400, csr=CSR-GW-01: Enforce IEEE 802.1X port-based access control and zero-trust DoIP authentication tokens.
      source=Infotainment Ethernet Segment, target=Central Security Gateway Routing Core, interface=1000Base-T1 Inter-Domain Bridge, csr=CSR-GW-02: Implement hardware-accelerated rate limiting and Deep Packet Inspection (DPI) to mitigate CAN-FD flooding.
