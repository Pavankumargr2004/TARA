AUTOSAR XML (schema 4.0)
package /ZoneArchitecture2026
  system Zonal_EE_System: category=ZONE_CONTROLLER_ARCHITECTURE
  security event collector SECMON_AUTOSAR_Module: logging-protocol=SOME/IP-TP
    trust-boundaries:
      source=In-Cabin Infotainment Zone, target=Central Compute Cluster (HPC), interface=SOME/IP Service Proxy, csr=CSR-ZONE-01: Central compute cluster shall isolate HPC hypervisor domains using hardware IOMMU memory protection.
      source=Zone Controller Front-Right, target=Zone Controller Front-Left (Powertrain), interface=1000Base-T1 Ethernet Ring, csr=CSR-ZONE-02: Enforce MACsec encryption on all inter-zonal ethernet backbones.
